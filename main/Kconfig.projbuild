## main/Kconfig.projbuild
```kconfig
menu "Wifi Configuration"

config WIFI_SSID
    string "WiFi SSID"
	default "myssid"
	help
		SSID (network name) for the example to connect to.

config WIFI_PASSWORD
    string "WiFi Password"
	default "myssid"
	help
		WiFi password (WPA or WPA2) for the example to use.

		Can be left blank if the network has no security set.

endmenu

menu "MQTT Server Configuration"

config MQTT_SERVER
    string "MQTT Server"
    default "test.mosquitto.org"
    help
        MQTT_SERVER the MQTT server to connect to.

endmenu
```
